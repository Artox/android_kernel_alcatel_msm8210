/* Copyright (c) 2013, The Linux Foundation. All rights reserved.
 *
 * This program is free software; you can redistribute it and/or modify
 * it under the terms of the GNU General Public License version 2 and
 * only version 2 as published by the Free Software Foundation.
 *
 * This program is distributed in the hope that it will be useful,
 * but WITHOUT ANY WARRANTY; without even the implied warranty of
 * MERCHANTABILITY or FITNESS FOR A PARTICULAR PURPOSE.  See the
 * GNU General Public License for more details.
 */

/*---------------------------------------------------------------------------
 * This file is autogenerated file using gcdb parser. Please do not edit it.
 * Update input XML file to add a new entry or update variable in this file
 * VERSION = "1.0"
 *---------------------------------------------------------------------------*/
&soc {
	dsi_hx8389b_qhd_vid: qcom,mdss_dsi_hx8389b_qhd_video {
		compatible = "qcom,mdss-dsi-panel";
		status = "disable";
		qcom,mdss-dsi-panel-name = "hx8389b video mode dsi panel";
		qcom,mdss-dsi-panel-controller = <&mdss_dsi0>;
		qcom,mdss-dsi-panel-width = <540>;
		qcom,mdss-dsi-panel-height = <960>;
		qcom,mdss-pan-physical-width-dimension = <0>;
		qcom,mdss-pan-physical-height-dimension = <0>;
		qcom,mdss-dsi-h-left-border = <0>;
		qcom,mdss-dsi-h-right-border = <0>;
		qcom,mdss-dsi-v-top-border = <0>;
		qcom,mdss-dsi-v-bottom-border = <0>;
		qcom,mdss-dsi-bpp = <24>;
		qcom,mdss-dsi-panel-type = "dsi_video_mode";
		qcom,mdss-dsi-pixel-packing = <0>; /* used for 16bit mode*/
		qcom,mdss-dsi-panel-destination = "display_1";
		qcom,mdss-dsi-h-front-porch = <48>;
		qcom,mdss-dsi-h-back-porch = <60>;//80
		qcom,mdss-dsi-h-pulse-width = <12>;//32
		qcom,mdss-dsi-h-sync-skew = <0>;
		qcom,mdss-dsi-v-back-porch = <10>;//11
		qcom,mdss-dsi-v-front-porch = <9>;//9
		qcom,mdss-dsi-v-pulse-width = <2>;
		qcom,mdss-dsi-panel-clock-rate = <474410000>;
		qcom,mdss-dsi-panel-timings = [2e 1e 14 00 42 46 18 20 16 03 04 00];
		qcom,mdss-dsi-t-clk-post = <0x04>;
		qcom,mdss-dsi-t-clk-pre = <0x12>;
		qcom,mdss-dsi-underflow-color = <0xff>;
		qcom,mdss-dsi-border-color = <0>;
		qcom,mdss-dsi-bl-pmic-control-type = "bl_ctrl_wled";
//		qcom,mdss-dsi-bl-pmic-pwm-frequency = <50>;
//		qcom,mdss-dsi-bl-pmic-bank-select = <0>;
//		qcom,mdss-dsi-pwm-gpio = <&pm8941_mpps 5 0>;
		qcom,mdss-dsi-bl-min-level = <1>;
		qcom,mdss-dsi-bl-max-level = <255>;
		qcom,mdss-dsi-interleave-mode = <0>;
/* lcd panel infor type */
//		qcom,mdss-dsi-te-check-enable;
//		qcom,mdss-dsi-te-using-te-pin;
/* for esd detect baoqiang */
		qcom,mdss-dsi-esd-enable;
		qcom,mdss-dsi-esd-detect-mode= <1>;
/* for video mode  */
		qcom,mdss-dsi-h-sync-pulse = <1>;
//		qcom,mdss-dsi-hfp-power-mode;
//		qcom,mdss-dsi-hsa-power-mode;
//		qcom,mdss-dsi-hbp-power-mode;
		qcom,mdss-dsi-bllp-power-mode;
		qcom,mdss-dsi-bllp-eof-power-mode;
		qcom,mdss-dsi-traffic-mode = <1>;
		qcom,mdss-dsi-panel-framerate = <59>;//modify by zrl at 20140401 for RFTEST
/*  for command mode */
		qcom,mdss-dsi-te-dcs-command = <1>;
		qcom,mdss-dsi-te-v-sync-continue-lines = <0x3c>;
		qcom,mdss-dsi-te-v-sync-rd-ptr-irq-line = <0x2c>;
		qcom,mdss-dsi-te-pin-select = <1>;
		qcom,mdss-dsi-stream = <0>;
		qcom,mdss-dsi-mdp-trigger = <0>;
		qcom,mdss-dsi-dma-trigger = <4>;
		qcom,mdss-dsi-virtual-channel-id = <0>;
		qcom,mdss-dsi-color-order = <2>;
		qcom,mdss-dsi-lane-0-state;
		qcom,mdss-dsi-lane-1-state;
//		qcom,mdss-dsi-lane-2-state;
//		qcom,mdss-dsi-lane-3-state;
		qcom,mdss-dsi-lane-map = "lane_map_3012";/*Modified by Xiaodong.Chen at 2014.1.17 for compatible codec baseline about LNX.LA.3.2.1-05810-8x10.0*/
                qcom,mdss-dsi-on-command = [
			39 01 00 00 00 00 04 B9 FF 83 89
			39 01 00 00 00 00 08 BA 41 93 00 16 A4 00 18
			39 01 00 00 00 00 14 B1 00 00 07 E8 97 10 11 6f ef 27 2F 23 23 42 00 58 F2 20 00
			15 01 00 00 00 00 02 C6 08
			39 01 00 00 00 00 08 B2 00 00 78 08 03 3F 20
			39 01 00 00 00 00 18 B4 80 08 00 32 10 00 00 00 00 00 00 00 37 0A 40 04 37 0a 48 14 50 58 0A
			39 01 00 00 00 00 1e D5 00 00 4C 00 01 00 00 00 60 00 99 88 99 88 88 32 88 10 88 76 88 54 10 32 88 88 88 88 88
			39 01 00 00 00 00 23 E0 04 0F 14 2D 34 3F 1e 3B 06 0E 0F 12 12 11 13 15 1D 04 0F 14 2D 34 3F 1e 3B 06 0E 0F 12 12 11 13 15 1D
			15 01 00 00 00 00 02 CC 02
			39 01 00 00 00 00 05 B6 00 a5 00 a5
			15 01 00 00 00 00 02 3A 77
			15 01 00 00 00 00 02 35 00
			05 01 00 00 78 00 01 11
			05 01 00 00 00 00 01 29];
		qcom,mdss-dsi-off-command = [
		        05 01 00 00 78 00 02 10 00];
		qcom,mdss-dsi-on-command-state = "dsi_lp_mode";
		qcom,mdss-dsi-off-command-state = "dsi_hs_mode";
		qcom,mdss-dsi-reset-sequence = <2 20>, <0 2>, <2 20>;
		
	};
};
