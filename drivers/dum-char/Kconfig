## drivers/dum-char/Kconfig
```kconfig
config MTK_MMC
	bool
	default y
	help
	  this file is usr to show the phone flash partition information,
	  and this file is coyped form MTK platform. so it may dose not work well!!!^_^
```

## kernel/Kconfig.freezer
```kconfig
config FREEZER
	def_bool PM_SLEEP || CGROUP_FREEZER
config JRD_PRINTD
    def_bool n
config JRD_DUMP_PROCESS
    def_bool n
```
